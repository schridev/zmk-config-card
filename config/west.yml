## config/west.yml
```yaml
manifest:
  remotes:
    - name: schridev
      url-base: https://github.com/schridev
  projects:
    - name: zmk
      remote: schridev
      revision: main
      import: app/west.yml
  self:
    path: config
```
